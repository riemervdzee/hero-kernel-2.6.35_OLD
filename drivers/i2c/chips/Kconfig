## drivers/i2c/chips/Kconfig
```kconfig
#
# Miscellaneous I2C chip drivers configuration
#
# *** DEPRECATED! Do not add new entries! See Makefile ***
#

menu "Miscellaneous I2C Chip support"

config MICROP_I2C
        tristate "MICROP Driver"
        depends on I2C
        help
          HTC Microp-P support.

config SENSORS_BMA150
        tristate "BMA150 G-sensor Driver"
        depends on I2C
        help
         BMA150 G-sensor Driver implemented by HTC.

config SENSORS_MT9T013
	tristate "MT9T013 Camera Driver"
	depends on I2C
	default y
	help
	 MT9T013 Camera Driver implemented by HTC.

endmenu
```
